## sdkconfig.defaults
```kconfig
CONFIG_TINYUSB_HID_COUNT=3
CONFIG_TINYUSB_ENABLED=y
CONFIG_TINYUSB_HID_ENABLED=y
CONFIG_TINYUSB_CDC_ENABLED=y
CONFIG_TINYUSB_CDC_COUNT=1
CONFIG_TINYUSB_CDC_RX_BUFSIZE=512
CONFIG_TINYUSB_CDC_TX_BUFSIZE=512
CONFIG_ESP32S3_DATA_CACHE_64KB=y
CONFIG_SPIRAM_MODE_OCT=y
```
